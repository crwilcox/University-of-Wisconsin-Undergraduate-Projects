; ADuC7026.inc
; defines for ADuC7026 MMRs

;interrupt control
IRQCON_MMR_BASE	EQU 0xFFFF0000
IRQSTA			EQU	0x00
IRQSIG			EQU	0x04
IRQEN			EQU	0x08
IRQCLR			EQU	0x0C
SWICFG			EQU	0x10
FIQSTA			EQU	0x100
FIQSIG			EQU	0x104
FIQEN			EQU	0x108
FIQCLR			EQU	0x10C

;system control
SYSCON_MMR_BASE	EQU 0xFFFF0200
REMAP			EQU	0x20
RSTSTA			EQU	0x30
RSTCLR			EQU	0x34

;timers
TIMER_MMR_BASE	EQU 0xFFFF0300
T0LD			EQU	0x00
T0VAL			EQU	0x04
T0CON			EQU	0x08
T0CLRI			EQU	0x0C
T1LD			EQU	0x20
T1VAL			EQU	0x24
T1CON			EQU	0x28
T1CLRI			EQU	0x2C
T1CAP			EQU	0x30
T2LD			EQU	0x40
T2VAL			EQU	0x44
T2CON			EQU	0x48
T2CLRI			EQU	0x4C
T3LD			EQU	0x60
T3VAL			EQU	0x64
T3CON			EQU	0x68
T3CLRI			EQU	0x6C

;PLL and power
PLL_MMR_BASE	EQU 0xFFFF0400
PLLKEY1			EQU	0x10
PLLCON			EQU	0x14
PLLKEY2			EQU	0x18
POWKEY1			EQU	0x04
POWCON			EQU	0x08
POWKEY2			EQU	0x0C

;PSM
PSM_MMR_BASE	EQU 0xFFFF0440
PSMCON			EQU	0x00
CMPCON			EQU	0x04

;REF
REF_MMR_BASE	EQU 0xFFFF0480
REFCON			EQU	0x0C

;ADC
ADC_MMR_BASE	EQU 0xFFFF0500
ADCCON			EQU	0x00
ADCCP			EQU	0x04
ADCCN			EQU	0x08
ADCSTA			EQU	0x0C
ADCDAT			EQU	0x10
ADCRST			EQU	0x14
ADCGN			EQU	0x30
ADCOF			EQU	0x34

;DAC
DAC_MMR_BASE	EQU 0xFFFF0600
DAC0CON			EQU	0x00
DAC0DAT			EQU	0x04
DAC1CON			EQU	0x08
DAC1DAT			EQU	0x0C
DAC2CON			EQU	0x10
DAC2DAT			EQU	0x14
DAC3CON			EQU	0x18
DAC3DAT			EQU	0x1C

;UART
UART_MMR_BASE	EQU 0xFFFF0700
COMTX			EQU	0x00
COMRX			EQU	0x00
COMDIV0			EQU	0x00
COMIEN0			EQU	0x04
COMDIV1			EQU	0x04
COMIID0			EQU	0x08
COMCON0			EQU	0x0C
COMCON1			EQU	0x10
COMSTA0			EQU	0x14
COMSTA1			EQU	0x18
COMSCR			EQU	0x1C
COMIEN1			EQU	0x20
COMIID1			EQU	0x24
COMADR			EQU	0x28
COMDIV2			EQU	0x2C

;external memory interface
XM_MMR_BASE		EQU 0xFFFFF000
XMCFG			EQU	0x00
XM0CON			EQU	0x10
XM1CON			EQU	0x14
XM2CON			EQU	0x18
XM3CON			EQU	0x1C
XM0PAR			EQU	0x20
XM1PAR			EQU	0x24
XM2PAR			EQU	0x28
XM3PAR			EQU	0x2C

;GPIO
GPIO_MMR_BASE	EQU 0xFFFFF400
GP0CON			EQU	0x00
GP1CON			EQU	0x04
GP2CON			EQU	0x08
GP3CON			EQU	0x0C
GP4CON			EQU	0x10
GP0DAT			EQU	0x20
GP0SET			EQU	0x24
GP0CLR			EQU	0x28
GP0PAR			EQU	0x2C
GP1DAT			EQU	0x30
GP1SET			EQU	0x34
GP1CLR			EQU	0x38
GP1PAR			EQU	0x3C
GP2DAT			EQU	0x40
GP2SET			EQU	0x44
GP2CLR			EQU	0x48
GP3DAT			EQU	0x50
GP3SET			EQU	0x54
GP3CLR			EQU	0x58
GP3PAR			EQU	0x5C
GP4DAT			EQU	0x60
GP4SET			EQU	0x64
GP4CLR			EQU	0x68


	END
